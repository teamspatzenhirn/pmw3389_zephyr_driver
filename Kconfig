## drivers/sensor/pmw3389/Kconfig
```kconfig
# Copyright (c) 2021 Team Spatzenhirn
# SPDX-License-Identifier: Apache-2.0

config PMW3389
	bool "PMW3389 motion sensor"
	default y
	depends on DT_HAS_PIXART_PMW3389_ENABLED
	depends on SPI
	help
	  Enable PMW3389 motion sensor.
```

## dts/bindings/sensor/pixart,pmw3389.yaml
```yaml
# Copyright (c) 2022 Team Spatzenhirn
# SPDX-License-Identifier: Apache-2.0


description: |
  Motion Sensor

compatible: "pixart,pmw3389"

include: spi-device.yaml

properties:
  resolution:
    type: int
    required: true
    description: |
      Resolution in counts per inch, multiples of 50, from 50 to 16000
```
